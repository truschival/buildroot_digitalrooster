## package/digitalroostergui/Config.in
```kconfig
config BR2_PACKAGE_DIGITALROOSTERGUI
	bool "Digital Rooster"
	depends on BR2_PACKAGE_QT5BASE
	depends on BR2_PACKAGE_QT5DECLARATIVE
	depends on BR2_PACKAGE_OPENSSL
	depends on BR2_PACKAGE_QT5QUICKCONTROLS2
	depends on BR2_PACKAGE_WPA_SUPPLICANT
	depends on BR2_PACKAGE_QT5MULTIMEDIA
	select BR2_PACKAGE_QT5BASE_EGLFS
	select BR2_PACKAGE_QT5BASE_FONTCONFIG
	select BR2_PACKAGE_QT5BASE_PNG
	select BR2_PACKAGE_QT5BASE_JPEG
	select BR2_PACKAGE_DEJAVU
	select BR2_PACKAGE_DEJAVU_SANS
	select BR2_PACKAGE_DEJAVU_SANS_CONDENSED
	select BR2_PACKAGE_DEJAVU_SERIF
	select BR2_PACKAGE_DEJAVU_SERIF_CONDENSED
	select BR2_PACKAGE_DEJAVU_MONO 
	help
	Digital alarm clock and podcast / internet radio player

if BR2_PACKAGE_DIGITALROOSTERGUI
### Version selection
choice
prompt "Package Version"

config BR2_PACKAGE_DIGITALROOSTERGUI_VERSION_STABLE
	bool "master"
	help
	"latest stable version"

config BR2_PACKAGE_DIGITALROOSTERGUI_VERSION_DEVEL
	bool "develop"
	help
	"Latest development branch" 

endchoice

config BR2_PACKAGE_DIGITALROOSTERGUI_TEST
	bool "Build and install unit tests on target"

config BR2_PACKAGE_DIGITALROOSTERGUI_REST
	bool "Enable REST API"
	depends on BR2_PACKAGE_PISTACHE

config BR2_PACKAGE_DIGITALROOSTERGUI_REST_PORT
	int "REST API TCP port"
	default 6666
	depends on BR2_PACKAGE_DIGITALROOSTERGUI_REST

config BR2_PACKAGE_DIGITALROOSTERGUI_DEBUG
	bool
	prompt "Build with debug information "

endif #package
```

## package/fbcp/Config.in
```kconfig
config BR2_PACKAGE_FBCP
	bool "FBCP" if BR2_DIGITALROOSTER_TARGET_RPI_ZERO_W
	depends on BR2_DIGITALROOSTER_TARGET_RPI_ZERO_W
	select BR2_PACKAGE_RPI_USERLAND
	help
        Framebuffer Copy utility to capture /dev/fb0 and display 
        the content on /dev/fb1
```

## package/pistache/Config.in
```kconfig
config BR2_PACKAGE_PISTACHE
        bool "Pistache REST framework"
        help
          Pistache is a C++ REST framework written by Mathieu Stefani at
          Datacratic. It is written in pure C++11 with no external dependency and
          provides a low-level HTTP abstraction.  It provides both an HTTP client
          and server that can be used to create and query complex web and REST
          APIs.
```

## package/qttestgadget/Config.in
```kconfig
config BR2_PACKAGE_QTTESTGADGET
	bool "QT Test Gadget"
	depends on BR2_PACKAGE_QT5QUICKCONTROLS2
	depends on BR2_PACKAGE_QT5MULTIMEDIA
	
if BR2_PACKAGE_QTTESTGADGET

config BR2_PACKAGE_QTTESTGADGET_DEBUG
	bool
	prompt "Build with debug information "

endif #package
```
